## conf/machine/include/nvidia-orin-proprietary-license-recipes.inc
```bitbake
#
# WARNING: The following recipes include NVIDIA proprietary licenses.
# You must consult your legal department before enable them for the build
#

CUSTOMER_RECIPES:tegra += " \
    argus-samples \
    cuda-cccl \
    cuda-compat \
    cuda-crt \
    cuda-cudart \
    cuda-cuobjdump \
    cuda-cupti \
    cuda-cuxxfilt \
    cuda-driver \
    cuda-gdb \
    cuda-nvcc \
    cuda-nvcc-headers \
    cuda-nvdisasm \
    cuda-nvml \
    cuda-nvprune \
    cuda-nvrtc \
    cuda-nvtx \
    cuda-nvvm \
    cuda-profiler-api \
    cuda-sanitizer \
    cudnn \
    cudnn-samples \
    cupva \
    gstreamer1.0-plugins-nvarguscamerasrc \
    gstreamer1.0-plugins-nvcompositor \
    gstreamer1.0-plugins-nvv4l2camerasrc \
    gstreamer1.0-plugins-nvvidconv \
    gstreamer1.0-plugins-nvvideo4linux2 \
    gstreamer1.0-plugins-nvvideosinks \
    gstreamer1.0-plugins-tegra-binaryonly \
    l4t-graphics-demos \
    l4t-nvidia-glheaders \
    libcublas \
    libcudla \
    libcufft \
    libcufile \
    libcurand \
    libcusolver \
    libcusparse \
    libgstnvcustomhelper \
    libnpp \
    libnvjitlink \
    libnvvpi3 \
    nsight-systems \
    python3-tensorrt \
    tegra-binaries \
    tegra-bootfiles \
    tegra-configs \
    tegra-configs-alsa \
    tegra-eks-image-base \
    tegra-firmware \
    tegra-flashtools \
    tegra-libraries-camera \
    tegra-libraries-core \
    tegra-libraries-cuda \
    tegra-libraries-dla-compiler \
    tegra-libraries-eglcore \
    tegra-libraries-gbm-backend \
    tegra-libraries-glescore \
    tegra-libraries-glxcore \
    tegra-libraries-multimedia \
    tegra-libraries-multimedia-ds \
    tegra-libraries-multimedia-utils \
    tegra-libraries-multimedia-v4l \
    tegra-libraries-nvdsseimeta \
    tegra-libraries-nvml \
    tegra-libraries-nvsci \
    tegra-libraries-pva \
    tegra-mmapi \
    tegra-nv-boot-control-config \
    tegra-nvfancontrol \
    tegra-nvphs-base \
    tegra-nvpmodel-base \
    tegra-nvpower \
    tegra-nvs-base \
    tegra-nvsciipc-base \
    tegra-redundant-boot-base \
    tegra-storage-layout-base \
    tegra-uefi-prebuilt \
    tensorrt-core \
    tensorrt-plugins-prebuilt \
    tensorrt-trtexec-prebuilt \
    tos-prebuilt \
    xserver-xorg-video-nvidia \
    nvidia-kernel-oot-dtb \
    tegra-cuda-utils \
    gstreamer1.0-plugins-nvipcpipeline \
    gstreamer1.0-plugins-nvunixfd \
"
```

## conf/machine/nvidia-orin-agx.conf
```bitbake
#@TYPE: Machine
#@NAME: Nvidia Jetson AGX Orin 64GB
#@DESCRIPTION: Nvidia Jetson Orin dev kit (P3701-0005 module in P3737-0000 carrier)

DEFAULTTUNE ??= "armv8a-crc"
TEGRA_BOARDSKU ?= "0005"
TEGRA_BUPGEN_SPECS ?= "fab=300;boardsku=0005;boardrev=;chipsku=00:00:00:D0;bup_type=bl \
                       fab=300;boardsku=0005;boardrev=;bup_type=kernel"
TEGRA_FLASHVAR_BPFDTB_FILE ?= "tegra234-bpmp-3701-0005-3737-0000.dtb"
TEGRA_FLASHVAR_PMIC_CONFIG ?= "tegra234-mb1-bct-pmic-p3701-0005.dts"
TEGRA_FLASHVAR_WB0SDRAM_BCT ?= "tegra234-p3701-0005-wb0sdram-l4t.dts"

EMMC_BCT ?= "tegra234-p3701-0005-sdram-l4t.dts"
ROOTFSPART_SIZE_DEFAULT ?= "59055800320"

require ${@bb.utils.contains('BUILD_NVIDIA_PROPRIETARY_PACKAGE', '1', \
			     '', 'conf/machine/include/arm/arch-armv8-2a.inc', d)}
require ${@bb.utils.contains('BUILD_NVIDIA_PROPRIETARY_PACKAGE', '1', \
			     'conf/machine/include/agx-orin.inc', '', d)}
require ${@bb.utils.contains('BUILD_NVIDIA_PROPRIETARY_PACKAGE', '1', \
			     'conf/machine/include/devkit-wifi.inc', '', d)}

MACHINE_FEATURES ??= "alsa usbhost pci rtc ext2"

KERNEL_IMAGETYPE ?= "Image"

SERIAL_CONSOLES ??= "115200;ttyTCU0"

KERNEL_DEVICETREE = "${@bb.utils.contains('BUILD_NVIDIA_PROPRIETARY_PACKAGE', '1', \
	'tegra234-p3737-0000+p3701-0005-nv.dtb', 'tegra234-p3737-0000+p3701-0000.dtb', d)}"

PREFERRED_PROVIDER_virtual/kernel ?= "linux-yocto"
PREFERRED_VERSION_linux-yocto ?= "6.12%"
PREFERRED_VERSION_linux-yocto-rt ?= "6.12%"

MACHINE_EXTRA_RRECOMMENDS:append = " kernel-modules"
IMAGE_FSTYPES += "tar.bz2 ext4"
IMAGE_INSTALL:append = " kernel-image-image"

MACHINEOVERRIDES:append = ":nvidia-orin"

# If enable reduntant flash layout, L4TConfiguration-RootfsRedundancyLevelABEnable.dtbo will be installed
USE_REDUNDANT_FLASH_LAYOUT_DEFAULT ?= "1"

BSP_NVIDIA_DERIVED:append=" nvidia-orin-agx"

TEGRA_PLUGIN_MANAGER_OVERLAYS:append = " ${@bb.utils.contains('BUILD_NVIDIA_PROPRIETARY_PACKAGE', '1', \
	'tegra234-p3737-camera-imx477-overlay.dtbo', '', d)}"
```

## conf/machine/nvidia-orin-nano.conf
```bitbake
#@TYPE: Machine
#@NAME: Nvidia Jetson Orin Nano 8GB (P3767-0003)
#@DESCRIPTION: Nvidia Jetson Orin dev kit (P3767-0003 module in P3768-0000 carrier)

DEFAULTTUNE ??= "armv8a-crc"

TNSPEC_BOOTDEV ?= "nvme0n1p1"
PARTITION_LAYOUT_TEMPLATE_DEFAULT ?= "flash_t234_qspi.xml"
PARTITION_LAYOUT_TEMPLATE_DEFAULT_SUPPORTS_REDUNDANT ?= "1"
PARTITION_LAYOUT_EXTERNAL_DEFAULT ?= "flash_l4t_t234_nvme.xml"

TEGRAFLASH_SDCARD_SIZE ?= "64G"
ROOTFSPART_SIZE_DEFAULT ?= "59055800320"

KERNEL_DEVICETREE ?= "tegra234-p3768-0000+p3767-0005-nv-super.dtb"

require ${@bb.utils.contains('BUILD_NVIDIA_PROPRIETARY_PACKAGE', '1', \
			     '', 'conf/machine/include/arm/arch-armv8-2a.inc', d)}
require ${@bb.utils.contains('BUILD_NVIDIA_PROPRIETARY_PACKAGE', '1', \
			     'conf/machine/include/orin-nano.inc', '', d)}
require ${@bb.utils.contains('BUILD_NVIDIA_PROPRIETARY_PACKAGE', '1', \
			     'conf/machine/include/devkit-wifi.inc', '', d)}

MACHINE_FEATURES ??= "alsa usbhost pci rtc ext2"

KERNEL_IMAGETYPE ?= "Image"

SERIAL_CONSOLES ??= "115200;ttyTCU0"

PREFERRED_PROVIDER_virtual/kernel ?= "linux-yocto"
PREFERRED_VERSION_linux-yocto ?= "6.12%"
PREFERRED_VERSION_linux-yocto-rt ?= "6.12%"

MACHINE_EXTRA_RRECOMMENDS:append = " kernel-modules"
IMAGE_FSTYPES += "tar.bz2"
IMAGE_INSTALL:append = " kernel-image-image"

MACHINEOVERRIDES:append = ":nvidia-orin:jetson-orin-nano-devkit"

# If enable reduntant flash layout, L4TConfiguration-RootfsRedundancyLevelABEnable.dtbo will be installed
USE_REDUNDANT_FLASH_LAYOUT_DEFAULT ?= "1"

BSP_NVIDIA_DERIVED:append=" nvidia-orin-nano"

TEGRA_PLUGIN_MANAGER_OVERLAYS:append = " ${@bb.utils.contains('BUILD_NVIDIA_PROPRIETARY_PACKAGE', '1', \
	'tegra234-p3767-camera-p3768-imx219-dual.dtbo', '', d)}"

BOOTABLE_OVERLAY ?= "tegra234-p3768-0000+p3767-0005-nv-super-boot-overlay.dtbo"

ASSUME_PROVIDED += "virtual/bootloader"
OSTREE_SD_UBOOT_WIC1 = ""
```

## conf/machine/nvidia-orin-nx.conf
```bitbake
#@TYPE: Machine
#@NAME: Nvidia Jetson Orin NX 16GB (P3767-0000)
#@DESCRIPTION: Nvidia Jetson Orin NX module in P3768 carrier

DEFAULTTUNE ??= "armv8a-crc"
require ${@bb.utils.contains('BUILD_NVIDIA_PROPRIETARY_PACKAGE', '1', \
			     '', 'conf/machine/include/arm/arch-armv8-2a.inc', d)}
require ${@bb.utils.contains('BUILD_NVIDIA_PROPRIETARY_PACKAGE', '1', \
			     'conf/machine/include/orin-nx.inc', '', d)}
require ${@bb.utils.contains('BUILD_NVIDIA_PROPRIETARY_PACKAGE', '1', \
			     'conf/machine/include/devkit-wifi.inc', '', d)}

MACHINE_FEATURES ??= "alsa usbhost pci rtc ext2"

KERNEL_IMAGETYPE ?= "Image"

SERIAL_CONSOLES ??= "115200;ttyTCU0"

KERNEL_DEVICETREE ??= "tegra234-p3768-0000+p3767-0000-nv-super.dtb"

PREFERRED_PROVIDER_virtual/kernel ?= "linux-yocto"
PREFERRED_VERSION_linux-yocto ?= "6.12%"
PREFERRED_VERSION_linux-yocto-rt ?= "6.12%"

MACHINE_EXTRA_RRECOMMENDS:append = " kernel-modules"
IMAGE_FSTYPES += "tar.bz2 ext4"
IMAGE_INSTALL:append = " kernel-image-image"

MACHINEOVERRIDES:append = ":nvidia-orin"

# If enable reduntant flash layout, L4TConfiguration-RootfsRedundancyLevelABEnable.dtbo will be installed
USE_REDUNDANT_FLASH_LAYOUT_DEFAULT ?= "0"

BSP_NVIDIA_DERIVED:append=" nvidia-orin-nx"

TEGRA_PLUGIN_MANAGER_OVERLAYS:append = " ${@bb.utils.contains('BUILD_NVIDIA_PROPRIETARY_PACKAGE', '1', \
	'tegra234-p3767-camera-p3768-imx219-dual.dtbo', '', d)}"

ASSUME_PROVIDED += "virtual/bootloader"
OSTREE_SD_UBOOT_WIC1 = ""
```
